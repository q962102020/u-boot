## arch/powerpc/cpu/mpc8260/Kconfig
```kconfig
menu "mpc8260 CPU"
	depends on MPC8260

config SYS_CPU
	default "mpc8260"

choice
	prompt "Target select"
	optional

config TARGET_SDLU
	bool "sdlu"

config TARGET_MPC8247DB
	bool "mpc8247db"

endchoice

source "board/huachuang/sdlu/Kconfig"

endmenu
```

## board/huachuang/sdlu/Kconfig
```kconfig
if TARGET_SDLU || TARGET_MPC8247DB
config MPC8247
	bool
	default y

config SYS_BOARD
	default "sdlu"

config SYS_VENDOR
	default "huachuang"

config SYS_CONFIG_NAME
	default "sdlu"

endif
```

## configs/sdlu_defconfig
```kconfig
CONFIG_PPC=y
# CONFIG_MMC is not set
CONFIG_MPC8260=y
CONFIG_TARGET_SDLU=y
CONFIG_SYS_TEXT_BASE=0xfff00000
#CONFIG_FIT=y
CONFIG_OF_BOARD_SETUP=y
CONFIG_VERSION_VARIABLE=y
CONFIG_HUSH_PARSER=y
CONFIG_AUTOBOOT_KEYED=y
CONFIG_AUTOBOOT_PROMPT="Hit <SPACE> key to stop autoboot in %2ds\n"
#CONFIG_CMD_ASKENV=y
#CONFIG_CMD_GREPENV=y
#CONFIG_CMD_I2C=y
#CONFIG_CMD_DHCP=y
#CONFIG_CMD_MII=y
CONFIG_CMD_PING=y
#CONFIG_CMD_UBI=y
CONFIG_MTD_NOR_FLASH=y
CONFIG_FLASH_CFI_DRIVER=y
CONFIG_SYS_FLASH_USE_BUFFER_WRITE=y
CONFIG_SYS_FLASH_CFI=y
CONFIG_ENV_IS_IN_FLASH=y
# CONFIG_PCI is not set
#CONFIG_OF_LIBFDT=y
```
